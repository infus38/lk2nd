/dts-v1/;

#include <skeleton.dtsi>

/ {
	model = "Qualcomm MSM 8926 (Arima 8926SS)";
	compatible = "sony,flamingo", "qcom,msm8926", "lk2nd,device";
	qcom,board-id = <8 0>;
	qcom,msm-id = <200 0>, 
		<224 0>, 
		<200 0x10001>, 
		<224 0x10001>;

	lk2nd,recovery-partition-name = "FOTAKernel";
};